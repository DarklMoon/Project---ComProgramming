#include <LiquidCrystal.h> //LCD
#include <Keypad.h> //Keypad
#include <math.h>//Math
#include <stdlib.h>//standard library

//เชื่อมต่อ LCD เข้ากับ Pin ต่างๆ
const int rs = 12, en = 11, d4 = 5, d5 = 4, d6 = 3, d7 = 2;
LiquidCrystal lcd(rs, en, d4, d5, d6, d7);

//จับคู่ keypad 
const byte ROWS = 4; 
const byte COLS = 4;
char keys[ROWS][COLS] = {
  {'1','2','3','A'},
  {'4','5','6','B'},
  {'7','8','9','C'},
  {'*','0','#','D'}
};
//
//เชื่อมต่อ keypad เข้ากับ pin ของ arduino
byte rowPins[ROWS] = {6, 7, 8, 9}; 
byte colPins[COLS] = {A1, A2, A3, A4}; 

int data_count = 0;//นำไปนับจำนวนของ Key ที่กด
char key;//นำไปรับข้อมูลจาก keypad
int key_state = 0;//นำไปรับสถานะของ keypad 4 สถานะ ได้แก่ ว่าง ถูกกด ปล่อย และกดค้าง
char last_key;//นำไปเก็บข้อมูล key ล่าสุดที่ถูกรับเข้ามา 
int mode = 0;//นำไปเก็บค่าโหมดต่างๆ เพื่อใช้ในการตรวจสอบการทำงานในขั้นตอนต่างๆ
String key1;//นำไปเก็บตัวเลขที่เรียงต่อกันจากการกด keypad
int binary_num, decimal_num = 0, base = 1, temp;//ตัวแปรใช้ในการคำนวณการแปลงตัว
int binary[10],count=0,check=7;//ตัวแปรใช้ในการคำนวณการแปลงตัว
long num = 0;//นำไปเก็บข้อมูลจาก key1 ที่เป็น String ให้เป็นตัวเลขเพื่อใช้ในการคำนวณ
char bit8[9]={'0','0','0','0','0','0','0','0','\0'};//ใช้สำหรับเก็บข้อมูล bit ที่เป็น binary
char num_false = 'F';//นำไปใช้เช็กค่าที่มาจาก keypad สำหรับโหมดแปลงเลขฐาน 2 ว่าเป็น 1 กับ 0 รึเปล่า

//ใช้คำสั่งสร้าง keypad ขึ้นมา
Keypad keypad = Keypad( makeKeymap(keys), rowPins, colPins, ROWS, COLS );

void setup(){
  Serial.begin(9600);//สั่งให้เริ่มทำงาน โดยใช้ความเร็วของอัตราบอดที่ 9600 bps
  //Check_EEPROM();//Call_function Check_EEPROM

  lcd.begin(16, 2); //กำหนดขนาดจอ (16 ตัวอักษร, 2 บรรทัด)
}
  
void loop()
{
  key = keypad.getKey(); //รับข้อมูลจาก keypad
  key_state = keypad.getState();//เก็บสถานะของตัว keypad                                 
                          
  if(key){//ถ้ามีการรับข้อมูลจาก keypad ให้เข้าเงื่อนไขนี้
    last_key = key; //เก็บ key เข้าไปอีกตัวแปร
    Serial.println(key);//แสดงผล key ที่รับจาก keypad ในหน้อจอทดสอบ
  }
//
  if(key == 'A'){//หากกด key A
      lcd.clear();//เคลียร์หน้าจอ LCD
      mode = 1;//เปลี่ยนเป็นโหมด 1 (สำหรับแปลงเลขฐาน 10 เป็น ฐาน 2)
      key1 = "";//รีเซตตัวแปรเก็บ key เพื่อนำไปรับข้อมูลใหม่ 
      data_count = 0;//รีเซตตัวแปรนับจำนวณครั้งที่กด เพื่อนำไปรับข้อมูลใหม่
  }//
  else if(key == 'B'){
      lcd.clear();//เคลียร์หน้าจอ LCD
      mode = 2;//เปลี่ยนเป็นโหมด 2 (สำหรับแปลงเลขฐาน 2 เป็น ฐาน 10)
      key1 = "";//รีเซตตัวแปรเก็บ key เพื่อนำไปรับข้อมูลใหม่ 
      data_count = 0;//รีเซตตัวแปรนับจำนวณครั้งที่กด เพื่อนำไปรับข้อมูลใหม่
  }
	
  if(key == 'C' && mode != 3){//เมื่อกด c จะทำการลบค่า Input ออก
    key1 = "";//รีเซตตัวแปรเก็บ key เพื่อนำไปรับข้อมูลใหม่ 
    data_count = 0;//รีเซตตัวแปรนับจำนวณครั้งที่กด เพื่อนำไปรับข้อมูลใหม่
    num_false = 'F';//รีเซตตัวแปรที่ใช้สำหรับการเช็คตัวเลขที่นำเข้าว่าเป็น 0 1 รึเปล่า
    lcd.clear();//เคลียร์หน้าจอ LCD
  }

  if(key == '#'){
    num = 0;//รีเซตตัวเก็บตัวเลขเพื่อใช้ในการเก็บครั้งต่อไป
    for(int i=0; i<data_count; i++){
      num += (key1[i] - '0')*(pow(10,(data_count-i-1)));
      //เปลี่ยนตัวเลขที่เป็น String ให้อยู่ในรูปของตัวเลขชนิด long 
    }
    if(mode==1 && key=='#'){//หากเป็นโหมด 1 และมีการกด '#' ลงบน keypad
      lcd.clear();//เคลียร์หน้าจอ LCD
      if(num > 254){//หากตัวเลขที่รับเข้ามาเกิน 254 (255) 
      lcd.setCursor(2,0);//กำหนดให้แสดงข้อความตำแหน่งที่ 3(0-2) บรรทัดที่ 1
      lcd.print("!!!ERROR!!!");//แสดงข้อความบนจอ LCD
      lcd.setCursor(0,1);//กำหนดให้แสดงข้อความตำแหน่งที่ 1(0) บรรทัดที่ 2
      lcd.print("PLEASE-TRY-AGAIN");//แสดงข้อความบนจอ LCD
      delay(3000);//ค้างข้อความไว้ 3 วินาที
      key1 = "";//รีเซตตัวแปรเก็บ key เพื่อนำไปรับข้อมูลใหม่ 
      key = 0;//ทำให้ค่าที่รับจาก keypad เข้ามาล่าสุดเป็น 0 หรือไม่มี
      data_count = 0;//รีเซตตัวแปรนับจำนวณครั้งที่กด เพื่อนำไปรับข้อมูลใหม่
      lcd.clear();
      }
      else{
        decimal_toBinary();//เรียกใช้ฟังก์ชั่นแปลงเลขฐาน 10 เป็น ฐาน 2
        mode = 3;//เปลี่ยนเป็นโหมด 3 (เพื่อบอกว่าเลขได้ถูกนำไปแปลงแล้ว)
        }
    }
    else if(mode==2 && key=='#'){//หากเป็นโหมด 2 และมีการกด '#' ลงบน keypad
      lcd.clear();//เคลียร์หน้าจอ LCD
      
      //หากมี input นอกเหนือจาก 1 กับ 0 หรือจำนวนเลขฐานสองที่รับเข้ามาเกิน 8 จำนวน
      if(num_false != 'F' || data_count > 8){
      lcd.setCursor(2,0);//กำหนดให้แสดงข้อความตำแหน่งที่ 3(0-2) บรรทัดที่ 1
      lcd.print("!!!ERROR!!!");//แสดงข้อความบนจอ LCD
      lcd.setCursor(0,1);//กำหนดให้แสดงข้อความตำแหน่งที่ 1(0) บรรทัดที่ 2
      lcd.print("PLEASE-TRY-AGAIN");//แสดงข้อความบนจอ LCD
      delay(3000);//ค้างข้อความไว้ 3 วินาที
      key = 0;//ทำให้ค่าที่รับจาก keypad เข้ามาล่าสุดเป็น 0 หรือไม่มี
      key1 = "";//รีเซตตัวแปรเก็บ key เพื่อนำไปรับข้อมูลใหม่ 
      data_count = 0;//รีเซตตัวแปรนับจำนวณครั้งที่กด เพื่อนำไปรับข้อมูลใหม่
      num_false = 'F';//รีเซตตัวแปรที่ใช้สำหรับการเช็คตัวเลขที่นำเข้าว่าเป็น 0 1 รึเปล่า
      lcd.clear();//เคลียร์หน้าจอ LCD
      }
      else{
        binary_toDecimal();//เรียกใช้ฟังก์ชั่นแปลงเลขฐาน 2 เป็น ฐาน 10
        mode = 3;//เปลี่ยนเป็นโหมด 3 (เพื่อบอกว่าเลขได้ถูกนำไปแปลงแล้ว)
        }
    }
    
  }

  if(last_key == '*' && key_state == 2 && mode != 0 ){//หากกด * ค้างไว้จะเป็นการ clear เลข Input ที่รับจาก keypad มา
      mode = 0;//เปลี่ยน mode กลับมายังหน้าเมนู
      data_count = 0;//รีเซตตัวแปรนับจำนวณครั้งที่กด เพื่อนำไปรับข้อมูลใหม่
      lcd.clear();//เคลียร์หน้าจอ LCD
  }
  if(last_key == 'D' && key_state == 2){
    lcd.clear();//เคลียร์หน้าจอ LCD
    lcd.setCursor(0,0);//กำหนดให้แสดงข้อความตำแหน่งที่ 1(0) บรรทัดที่ 1
    lcd.print("COM->PROGRAMMING");//แสดงข้อความบนจอ LCD
    lcd.setCursor(2,1);//กำหนดให้แสดงข้อความตำแหน่งที่ 2(0-1) บรรทัดที่ 2
    lcd.print("IT19 - KMITL");//แสดงข้อความบนจอ LCD
    delay(5000);//delay 5 วินาที (แสดงข้อความค้างไว้ 5 วินาที)
    key1 = "";//รีเซตตัวแปรเก็บ key เพื่อนำไปรับข้อมูลใหม่ 
    data_count = 0;//รีเซตตัวแปรนับจำนวณครั้งที่กด เพื่อนำไปรับข้อมูลใหม่
    lcd.clear();//เคลียร์หน้าจอ LCD
    mode = 0;//เปลี่ยน mode กลับมายังหน้าเมนู
  }

  if(mode == 0){//หากเป็นโหมด 0
    lcd.setCursor(2,0);//กำหนดให้แสดงข้อความตำแหน่งที่ 2(0-1) บรรทัดที่ 1
    lcd.print("Select Mode");//แสดงข้อความบนจอ LCD
	  lcd.setCursor(0,1);//กำหนดให้แสดงข้อความตำแหน่งที่ 1(0) บรรทัดที่ 2
	  lcd.print("A(DTB) OR B(BTD)");//แสดงข้อความบนจอ LCD
  }
  else if(mode == 1){//หากเป็นโหมด 1
      lcd.setCursor(0,0);//กำหนดให้แสดงข้อความตำแหน่งที่ 1(0) บรรทัดที่ 1
      lcd.print("DECIMAL: 0-255");//แสดงข้อความบนจอ LCD
      lcd.setCursor(0,1);//กำหนดให้แสดงข้อความตำแหน่งที่ 1(0) บรรทัดที่ 2
      lcd.print("INPUT:");//แสดงข้อความบนจอ LCD
      delay(200);//delay 0.2 วินาที
    }
   else if(mode == 2){//หากเป็นโหมด 2
      lcd.setCursor(0,0);//กำหนดให้แสดงข้อความตำแหน่งที่ 1(0) บรรทัดที่ 1
      lcd.print("BINARY: 11111111");//แสดงข้อความบนจอ LCD
      lcd.setCursor(0,1);//กำหนดให้แสดงข้อความตำแหน่งที่ 1(0) บรรทัดที่ 2
      lcd.print("INPUT:");//แสดงข้อความบนจอ LCD
      delay(200);//delay 0.2 วินาที
    }

  //หากมีการรับค่าจาก keypad ที่ไม่ใช่ปุ่ม A B C D * และไม่ใช่ mode 3 
	if(key && key != 'A' && key != 'B' && key != 'C' && key != 'D' && key != '*' && mode != 3)
  {
    input_key(); //เรียกใช้ฟังก์ชั่น input_key()
    //ฟังก์ชั่นไว้สำหรับเก็บ key ที่รับมา และแสดงผล key บนหน้าจอ LCD
    
  }
}

void input_key(){
  lcd.setCursor(6,1);//กำหนดตำแหน่งให้แสดงข้อความที่ตำแหน่ง 7(0-6) บรรทัดที่ 2 
  key1 = key1 + key;//นำ key ที่ได้มาเก็บเรียงกัน 
  if (mode != 0)//หากไม่ได้อยู่ในหน้า menu 
    lcd.print(key1);//แสดงตัวเลขที่รับมาจาก keypad ผ่านหน้าจอ LCD  
  data_count++;//ตัวนับจำนวณครั้ง +1
  if (mode == 2 && key != '0' && key != '1'){
    //หากเลือกโหมด B (แปลงจากฐาน2 เป็น ฐาน10) แล้วรับค่านอกเหนือจาก 1 กับ 0 จะสั่งให้ตัวเช็คเท่ากับ T
      num_false = 'T';
  }
  delay(500);//delay 0.5 วินาที
}

void decimal_toBinary(){
  int i;//ประกาศตัวแปรใช้สำหรับการคำนวณ
  binary[8],count=0,check=7;//รีเซตค่า เพื่อใช้ในการคำนวณ
  if(data_count > 2){//หาจำนวนเลขที่รับเข้ามามีมากกว่า 2 ตำแหน่ง
    num++;
  }
  for(i=0;num>0;i++){//ใช้ ForLoop แปลงเลขฐานสิบไปเรื่อยๆ จนกว่าจะเหลือ 0
      binary[i]=num%2;
      num /= 2;
      count++;
  }    

  //แปลงเลขฐาน 2 ที่เก็บในลักษณะ array ที่เป็น integer ให้กลายเป็น array ที่เป็น character แทน
  for(i=i-1;i>=0;i--){
    bit8[check] = binary[count-(i+1)]+'0';// + '0' ต่อท้าย integer ทำให้กลายเป็น char ได้
    check--;
  }
  
  lcd.setCursor(0,0);//กำหนดให้แสดงข้อความตำแหน่งที่ 1(0) บรรทัดที่ 1
  lcd.print("-BINARY--OUTPUT-");//แสดงข้อความบนจอ LCD
  lcd.setCursor(4,1);//กำหนดให้แสดงข้อความตำแหน่งที่ 5(0-4) บรรทัดที่ 2
  lcd.print(bit8);//แสดงตัวเลขฐานสองบนจอ LCD

  key1 = "";//รีเซตตัวแปรเก็บ key เพื่อนำไปรับข้อมูลใหม่

}

void binary_toDecimal(){
    decimal_num = 0; base = 1; temp=0;//รีเซตค่า เพื่อใช้ในการคำนวณ
    if(data_count == 8)//ถ้าจำนวนเลขที่รับเข้ามา เท่ากับ 8 จำนวณ
      num += 16;
    else if(data_count != 2)//ถ้าจำนวนเลขที่รับเข้ามา ไม่เท่ากับ 2 จำนวณ
      num += 1;

    binary_num = num; 
    while (num > 0){//หาก num มากกว่า 0 ให้เข้า While Loop ในการแปลงเลขฐาน 2
        temp =  num % 10;
        decimal_num = decimal_num + temp * base;  
        num = num / 10;
        base = base * 2;  
    }
    char keep[(int) floor(log10(abs(decimal_num))) + 1];//กำหนดตัวแปร keep ขึ้นมาเพื่อใช้ในการเก็บตัวเลขฐานสิบ
    sprintf(keep, "%d", decimal_num);//นำเลขฐานสิบที่อยู่ในรูปแบบ integer ให้กลายเป็น String

    lcd.setCursor(0,0);//กำหนดให้แสดงข้อความตำแหน่งที่ 1(0) บรรทัดที่ 1
    lcd.print("-DECIMAL-OUTPUT-");//แสดงข้อความบนจอ LCD
    lcd.setCursor(7,1);//กำหนดให้แสดงข้อความตำแหน่งที่ 8(0-7) บรรทัดที่ 2
    lcd.print(keep);//แสดงตัวเลขฐานสิบบนจอ LCD

    key1 = "";//รีเซตตัวแปรเก็บ key เพื่อนำไปรับข้อมูลใหม่
}